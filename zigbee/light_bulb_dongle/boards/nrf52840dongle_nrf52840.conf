## zigbee/light_bulb_dongle/boards/nrf52840dongle_nrf52840.conf
```kconfig
# driver/subsys. Use the deferred mode instead.
CONFIG_LOG_MODE_DEFERRED=y
CONFIG_USB_CDC_ACM_LOG_LEVEL_OFF=y
CONFIG_PRINTK=y
CONFIG_PWM=y
CONFIG_LOG=y
```
